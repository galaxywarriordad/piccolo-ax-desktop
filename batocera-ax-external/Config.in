## batocera-ax-external/Config.in
```kconfig
config BR2_PACKAGE_PICCOLO_AX_DESKTOP
	bool "Piccolo-AX Desktop Mode (Tier A Core)"
	help
	  Enables the decoupled piccolo-ax-desktop layer (LXQt/XFCE,
	  Falkon, office, readers, and 2D/pixel graphics suite).

if BR2_PACKAGE_PICCOLO_AX_DESKTOP
source "$(BR2_EXTERNAL_PICCOLO_AX_PATH)/../piccolo-ax-desktop/buildroot/Config.in"
endif
```

## buildroot/Config.in
```kconfig
menu "Piccolo-AX Desktop Custom Packages"
	if BR2_EXTERNAL_PICCOLO_AX_DESKTOP_PATH != ""
		source "$BR2_EXTERNAL_PICCOLO_AX_DESKTOP_PATH/buildroot/package/azpainter/Config.in"
		source "$BR2_EXTERNAL_PICCOLO_AX_DESKTOP_PATH/buildroot/package/libresprite/Config.in"
		source "$BR2_EXTERNAL_PICCOLO_AX_DESKTOP_PATH/buildroot/package/ghex/Config.in"
		source "$BR2_EXTERNAL_PICCOLO_AX_DESKTOP_PATH/buildroot/package/cpu-x/Config.in"
	endif
	if BR2_EXTERNAL_PICCOLO_AX_DESKTOP_PATH = "" && BR2_EXTERNAL_PICCOLO_AX_PATH != ""
		source "$BR2_EXTERNAL_PICCOLO_AX_PATH/../piccolo-ax-desktop/buildroot/package/azpainter/Config.in"
		source "$BR2_EXTERNAL_PICCOLO_AX_PATH/../piccolo-ax-desktop/buildroot/package/libresprite/Config.in"
		source "$BR2_EXTERNAL_PICCOLO_AX_PATH/../piccolo-ax-desktop/buildroot/package/ghex/Config.in"
		source "$BR2_EXTERNAL_PICCOLO_AX_PATH/../piccolo-ax-desktop/buildroot/package/cpu-x/Config.in"
	endif
endmenu
```

## buildroot/package/azpainter/Config.in
```kconfig
config BR2_PACKAGE_AZPAINTER
	bool "azpainter"
	depends on BR2_PACKAGE_XORG7
	depends on BR2_USE_WCHAR
	depends on BR2_TOOLCHAIN_HAS_THREADS
	select BR2_PACKAGE_XLIB_LIBX11
	select BR2_PACKAGE_XLIB_LIBXEXT
	select BR2_PACKAGE_XLIB_LIBXI
	select BR2_PACKAGE_XLIB_LIBXCURSOR
	select BR2_PACKAGE_FREETYPE
	select BR2_PACKAGE_FONTCONFIG
	select BR2_PACKAGE_LIBPNG
	select BR2_PACKAGE_JPEG
	select BR2_PACKAGE_ZLIB
	help
	  Lightweight 16-bit full-color illustration and painting
	  application for Linux/X11.

	  https://gitlab.com/azelpg/azpainter

comment "azpainter needs X.org and a toolchain w/ wchar, threads"
	depends on !BR2_PACKAGE_XORG7 || !BR2_USE_WCHAR || !BR2_TOOLCHAIN_HAS_THREADS
```

## buildroot/package/cpu-x/Config.in
```kconfig
config BR2_PACKAGE_CPU_X
	bool "cpu-x"
	depends on BR2_i386 || BR2_x86_64
	depends on BR2_INSTALL_LIBSTDCPP
	depends on BR2_USE_WCHAR
	depends on BR2_TOOLCHAIN_HAS_THREADS
	depends on BR2_PACKAGE_LIBGTK3
	select BR2_PACKAGE_NCURSES
	select BR2_PACKAGE_PCIUTILS
	select BR2_PACKAGE_PROCPS_NG
	help
	  System profiling and monitoring tool (CPU-Z equivalent)
	  displaying CPU clocks, caches, motherboard, memory, and
	  GPU/PCI hardware details in both GTK3 GUI and ncurses TUI.

	  https://github.com/TheTumultuousUnicornOfDarkness/CPU-X

comment "cpu-x needs x86/x86_64, GTK3, and a toolchain w/ C++, wchar, threads"
	depends on !(BR2_i386 || BR2_x86_64) || !BR2_INSTALL_LIBSTDCPP || \
		!BR2_USE_WCHAR || !BR2_TOOLCHAIN_HAS_THREADS || !BR2_PACKAGE_LIBGTK3
```

## buildroot/package/ghex/Config.in
```kconfig
menu "Piccolo-AX Desktop Custom Packages"
	source "$BR2_EXTERNAL_PICCOLO_AX_DESKTOP_PATH/buildroot/package/azpainter/Config.in"
	source "$BR2_EXTERNAL_PICCOLO_AX_DESKTOP_PATH/buildroot/package/libresprite/Config.in"
	source "$BR2_EXTERNAL_PICCOLO_AX_DESKTOP_PATH/buildroot/package/ghex/Config.in"
	source "$BR2_EXTERNAL_PICCOLO_AX_DESKTOP_PATH/buildroot/package/cpu-x/Config.in"
endmenu
```

## buildroot/package/libresprite/Config.in
```kconfig
config BR2_PACKAGE_LIBRESPRITE
	bool "libresprite"
	depends on BR2_INSTALL_LIBSTDCPP
	depends on BR2_USE_WCHAR
	depends on BR2_TOOLCHAIN_HAS_THREADS
	select BR2_PACKAGE_SDL2
	select BR2_PACKAGE_SDL2_IMAGE
	select BR2_PACKAGE_LIBPNG
	select BR2_PACKAGE_JPEG
	select BR2_PACKAGE_GIFLIB
	select BR2_PACKAGE_ZLIB
	select BR2_PACKAGE_PIXMAN
	select BR2_PACKAGE_FREETYPE
	select BR2_PACKAGE_TINYXML2
	select BR2_PACKAGE_LIBCURL
	help
	  Animated sprite editor and pixel-art creation tool.

	  https://github.com/LibreSprite/LibreSprite

comment "libresprite needs a toolchain w/ C++, wchar, threads"
	depends on !BR2_INSTALL_LIBSTDCPP || !BR2_USE_WCHAR || \
		!BR2_TOOLCHAIN_HAS_THREADS
```
